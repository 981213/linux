## Documentation/devicetree/bindings/clock/mediatek,mt7621-pll.txt
```
Binding for Mediatek MT7621 PLL controller

The PLL controller provides the 2 main clocks of the SoC: CPU and BUS.

Required Properties:
- compatible: has to be "mediatek,mt7621-pll"
- #clock-cells: has to be one

Optional properties:
- clock-output-names: should be "cpu", "bus"

Example:
	pll {
		compatible = "mediatek,mt7621-pll";

		#clock-cells = <1>;
		clock-output-names = "cpu", "bus";
	};
```
