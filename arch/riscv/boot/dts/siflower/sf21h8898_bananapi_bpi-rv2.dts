// SPDX-License-Identifier: (GPL-2.0 OR MIT)
/dts-v1/;

#include "sf21h8898.dtsi"

/ {
	model = "Banana Pi BPI-RV2";
	compatible = "bananapi,bpi-rv2", "siflower,sf21h8898";

	chosen {
		stdout-path = "serial1:115200n8";
	};

	memory@20000000 {
		device_type = "memory";
		reg = <0x0 0x20000000 0x0 0x20000000>;
	};
};

&uart1 {
	status = "okay";
};
